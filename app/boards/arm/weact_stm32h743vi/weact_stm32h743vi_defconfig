## app/boards/arm/weact_stm32h743vi/weact_stm32h743vi_defconfig
```kconfig
# SPDX-License-Identifier: Apache-2.0

CONFIG_SOC_SERIES_STM32H7X=y
CONFIG_SOC_STM32H743XX=y
# 480MHz system clock
CONFIG_SYS_CLOCK_HW_CYCLES_PER_SEC=480000000

# Enable MPU
CONFIG_ARM_MPU=y

# Enable HW stack protection
CONFIG_HW_STACK_PROTECTION=y

CONFIG_PINMUX=y

# Enable UART
CONFIG_SERIAL=y

## Enable DMA
#CONFIG_DMA=y

# Console
CONFIG_CONSOLE=y
CONFIG_UART_CONSOLE=y

# Enable GPIO
CONFIG_GPIO=y

# Clock Configuration
CONFIG_CLOCK_CONTROL=y

CONFIG_PINCTRL=y
```

## app/tests/obstacle_test/testcase.yaml
```yaml
tests:
  # section.subsection
  obstacles.testing.ztest:
    platform_allow: native_posix
    integration_platforms:
      - native_posix
    tags: testing
```

## app/tests/pathfinding_test/testcase.yaml
```yaml
tests:
  # section.subsection
  pathfinding.testing.ztest:
    platform_allow: native_posix
    integration_platforms:
      - native_posix
    tags: testing
```

## app/tests/sample_test/testcase.yaml
```yaml
tests:
  # section.subsection
  testing.ztest:
    platform_allow: native_posix
    tags: testing
```

## boards/arm/nucleo_g491re/Kconfig.board
```kconfig
# STM32G491RE Nucleo board configuration

# Copyright (c) 2019 Richard Osterloh <richard.osterloh@gmail.com>
# SPDX-License-Identifier: Apache-2.0

config BOARD_NUCLEO_G491RE
	bool "Nucleo G491RE Development Board"
	depends on SOC_STM32G491XX
```

## boards/arm/nucleo_g491re/Kconfig.defconfig
```kconfig
# STM32G491RE Nucleo board configuration

# Copyright (c) 2019 Richard Osterloh <richard.osterloh@gmail.com>
# SPDX-License-Identifier: Apache-2.0

if BOARD_NUCLEO_G491RE

config BOARD
	default "nucleo_g491re"

config SPI_STM32_INTERRUPT
	default y
	depends on SPI

endif # BOARD_NUCLEO_G491RE
```
